## src/mainboard/dell/precision_m4800_3dfx/Kconfig
```kconfig
if BOARD_DELL_PRECISION_M4800_3DFX

config BOARD_SPECIFIC_OPTIONS
	def_bool y
	select BOARD_ROMSIZE_KB_12288
	select ACPI_S1_NOT_SUPPORTED
	select DISABLE_ACPI_HIBERNATE
	select EC_ACPI
	select EC_DELL_MEC5035
	select HAVE_ACPI_TABLES
	select HAVE_CMOS_DEFAULT
	select HAVE_OPTION_TABLE
	select MAINBOARD_HAS_TPM1
	select MAINBOARD_USES_IFD_GBE_REGION
	select MEMORY_MAPPED_TPM
	select NORTHBRIDGE_INTEL_HASWELL
	select SERIRQ_CONTINUOUS_MODE
	select SOUTHBRIDGE_INTEL_LYNXPOINT
	select SYSTEM_TYPE_LAPTOP

config MAINBOARD_DIR
	default "dell/precision_m4800_3dfx"

config MAINBOARD_PART_NUMBER
	default "Precision M4800 3dfx Edition"

config USBDEBUG_HCD_INDEX
	default 2

endif
```
